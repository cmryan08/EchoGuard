## .kiro/sessions/ee664c46224288bc/sess_01e82f32-d780-4a6b-9085-c8727f725ba9/snapshots/cfd21024/firmware/receiver/main/Kconfig.projbuild
```kconfig
menu "EchoGuard receiver"

    config ECHOGUARD_RX_CHANNEL
        int "Wi-Fi channel (must match the transmitter)"
        range 1 13
        default 11
        help
            Must equal ECHOGUARD_TX_CHANNEL of the transmitter. Channel 11 is the
            official esp-csi example default.

    config ECHOGUARD_RX_LLTF_ONLY
        bool "Print only the LLTF part of the CSI (first 128 values)"
        depends on !(IDF_TARGET_ESP32C5 || IDF_TARGET_ESP32C6 || IDF_TARGET_ESP32C61)
        default y
        help
            Classic targets (ESP32/S3/C3) report LLTF (64 subcarriers = 128 int8
            values) followed by HT-LTF / STBC-HT-LTF for HT packets (up to 384
            values). Printing everything at 100 Hz exceeds what a 921600 baud UART
            can carry, so by default only the LLTF part is printed and the 'len'
            column is set to the number of values actually printed.

    config ECHOGUARD_RX_MAX_CSI_BYTES
        int "Maximum CSI bytes copied per packet"
        range 128 612
        default 612 if IDF_TARGET_ESP32C5 || IDF_TARGET_ESP32C6 || IDF_TARGET_ESP32C61
        default 384
        help
            Size of the per-packet CSI copy in the queue item. Longer CSI buffers
            are truncated and the printed 'len' reflects the truncated length.

    config ECHOGUARD_RX_QUEUE_LEN
        int "CSI queue depth (packets)"
        range 4 128
        default 32
        help
            Number of CSI packets buffered between the Wi-Fi CSI callback and the
            printer task. When full, packets are dropped and counted in
            EG_RX_STATS queue_drops.

    config ECHOGUARD_RX_GAIN_COMPENSATION
        bool "Multiply printed CSI values by the gain compensation factor"
        default n
        help
            When y, each CSI value is multiplied by esp_csi_gain_ctrl's
            compensate_gain (relative to the AGC/FFT gain baseline recorded from
            the first 100 packets after boot) before printing, as the official
            csi_recv example does. Off by default: the product is truncated to
            an integer, which destroys resolution when compensate_gain < 1 (the
            values collapse to 0..3 LSB), and the EchoGuard host normalises the
            gain of every packet anyway. The gain values are always reported in
            the once-per-second EG_RX_GAIN line.

    config ECHOGUARD_RX_FORCE_GAIN
        bool "Lock the AGC/FFT gain to the boot-time baseline"
        default n
        help
            When y, the receiver forces the AGC/FFT gain to the baseline recorded
            from the first 100 packets after boot. Keeps the CSI scale constant
            but may cause packet loss if the signal level changes a lot later.

    config ECHOGUARD_RX_CSI_SHIFT
        int "CSI scaling (0 = automatic, 1..15 = manual left shift)"
        depends on !(IDF_TARGET_ESP32C5 || IDF_TARGET_ESP32C6 || IDF_TARGET_ESP32C61)
        range 0 15
        default 0
        help
            0 keeps the Wi-Fi driver's automatic CSI scaling (official default).
            1..15 sets wifi_csi_config_t.manu_scale = true with this left shift.
            Classic targets (ESP32/S3/C3) only.

endmenu
```

## .kiro/sessions/ee664c46224288bc/sess_01e82f32-d780-4a6b-9085-c8727f725ba9/snapshots/e39a6cb6/firmware/receiver/main/Kconfig.projbuild
```kconfig
menu "EchoGuard receiver"

    config ECHOGUARD_RX_CHANNEL
        int "Wi-Fi channel (must match the transmitter)"
        range 1 13
        default 11
        help
            Must equal ECHOGUARD_TX_CHANNEL of the transmitter. Channel 11 is the
            official esp-csi example default.

    config ECHOGUARD_RX_LLTF_ONLY
        bool "Print only the LLTF part of the CSI (first 128 values)"
        depends on !(IDF_TARGET_ESP32C5 || IDF_TARGET_ESP32C6 || IDF_TARGET_ESP32C61)
        default y
        help
            Classic targets (ESP32/S3/C3) report LLTF (64 subcarriers = 128 int8
            values) followed by HT-LTF / STBC-HT-LTF for HT packets (up to 384
            values). Printing everything at 100 Hz exceeds what a 921600 baud UART
            can carry, so by default only the LLTF part is printed and the 'len'
            column is set to the number of values actually printed.

    config ECHOGUARD_RX_MAX_CSI_BYTES
        int "Maximum CSI bytes copied per packet"
        range 128 612
        default 612 if IDF_TARGET_ESP32C5 || IDF_TARGET_ESP32C6 || IDF_TARGET_ESP32C61
        default 384
        help
            Size of the per-packet CSI copy in the queue item. Longer CSI buffers
            are truncated and the printed 'len' reflects the truncated length.

    config ECHOGUARD_RX_QUEUE_LEN
        int "CSI queue depth (packets)"
        range 4 128
        default 32
        help
            Number of CSI packets buffered between the Wi-Fi CSI callback and the
            printer task. When full, packets are dropped and counted in
            EG_RX_STATS queue_drops.

endmenu
```

## firmware/transmitter/main/Kconfig.projbuild
```kconfig
menu "EchoGuard transmitter"

    config ECHOGUARD_TX_CHANNEL
        int "Wi-Fi channel (must match the receiver)"
        range 1 13
        default 11
        help
            Fixed 2.4 GHz channel used for the ESP-NOW broadcast. The receiver
            must be built with the same ECHOGUARD_RX_CHANNEL. Channel 11 is the
            official esp-csi example default. HT40 uses the secondary channel
            below the primary for channels 5..13 and above for channels 1..4.

    config ECHOGUARD_TX_RATE_HZ
        int "Packet send rate (packets per second)"
        range 10 200
        default 100
        help
            ESP-NOW broadcast rate. 100 Hz matches the official example and is
            enough to capture human motion. The effective rate is quantised to
            the FreeRTOS tick (CONFIG_FREERTOS_HZ=1000 -> 1 ms resolution).

endmenu
```
